# platform_designer_hps_system_hps_0_hps register map
Vendor: default_vendor.com; File version: 0.0
Registers are 32-bit, read-write, reset 0x0 unless marked. A register's access mark holds for its fields unless they carry their own. Offsets are from the block's base; [hi:lo] are bit positions; {n}, {i} and the like mark numbered series.

## sysmgr (part 3 of 3) — Registers in the System Manager module
Base 0xFFD08000
0x4B8 pinmuxgrp_GENERALIO14 — This register is used to control the peripherals connected to uart0_tx Only reset by a cold reset (ignores warm reset). NOTE: These registers should not be modified after IO configuration.There is no support for dynamically changing the Pin Mux selections.
  [1:0] sel — Select peripheral signals connected uart0_tx. 0 : Pin is connected to GPIO/LoanIO number 62. 1 : Pin is connected to Peripheral signal SPIM1.SS1. 2 : Pin is connected to Peripheral signal CAN0.TX. 3 : Pin is connected to Peripheral signal UART0.TX.
0x4BC pinmuxgrp_GENERALIO15 — This register is used to control the peripherals connected to i2c0_sda Only reset by a cold reset (ignores warm reset). NOTE: These registers should not be modified after IO configuration.There is no support for dynamically changing the Pin Mux selections.
  [1:0] sel — Select peripheral signals connected i2c0_sda. 0 : Pin is connected to GPIO/LoanIO number 63. 1 : Pin is connected to Peripheral signal SPIM1.CLK. 2 : Pin is connected to Peripheral signal UART1.RX. 3 : Pin is connected to Peripheral signal I2C0.SDA.
0x4C0 pinmuxgrp_GENERALIO16 — This register is used to control the peripherals connected to i2c0_scl Only reset by a cold reset (ignores warm reset). NOTE: These registers should not be modified after IO configuration.There is no support for dynamically changing the Pin Mux selections.
  [1:0] sel — Select peripheral signals connected i2c0_scl. 0 : Pin is connected to GPIO/LoanIO number 64. 1 : Pin is connected to Peripheral signal SPIM1.MOSI. 2 : Pin is connected to Peripheral signal UART1.TX. 3 : Pin is connected to Peripheral signal I2C0.SCL.
0x4C4 pinmuxgrp_GENERALIO17 — This register is used to control the peripherals connected to can0_rx Only reset by a cold reset (ignores warm reset). NOTE: These registers should not be modified after IO configuration.There is no support for dynamically changing the Pin Mux selections.
  [1:0] sel — Select peripheral signals connected can0_rx. 0 : Pin is connected to GPIO/LoanIO number 65. 1 : Pin is connected to Peripheral signal SPIM1.MISO. 2 : Pin is connected to Peripheral signal UART0.RX. 3 : Pin is connected to Peripheral signal CAN0.RX.
0x4C8 pinmuxgrp_GENERALIO18 — This register is used to control the peripherals connected to can0_tx Only reset by a cold reset (ignores warm reset). NOTE: These registers should not be modified after IO configuration.There is no support for dynamically changing the Pin Mux selections.
  [1:0] sel — Select peripheral signals connected can0_tx. 0 : Pin is connected to GPIO/LoanIO number 66. 1 : Pin is connected to Peripheral signal SPIM1.SS0. 2 : Pin is connected to Peripheral signal UART0.TX. 3 : Pin is connected to Peripheral signal CAN0.TX.
0x4CC pinmuxgrp_GENERALIO19 — This register is used to control the peripherals connected to spis1_clk Only reset by a cold reset (ignores warm reset). NOTE: These registers should not be modified after IO configuration.There is no support for dynamically changing the Pin Mux selections.
  [1:0] sel — Select peripheral signals connected spis1_clk. 0 : Pin is connected to GPIO/LoanIO number 67. 1 : Pin is connected to Peripheral signal not applicable. 2 : Pin is connected to Peripheral signal SPIM1.CLK. 3 : Pin is connected to Peripheral signal SPIS1.CLK.
0x4D0 pinmuxgrp_GENERALIO20 — This register is used to control the peripherals connected to spis1_mosi Only reset by a cold reset (ignores warm reset). NOTE: These registers should not be modified after IO configuration.There is no support for dynamically changing the Pin Mux selections.
  [1:0] sel — Select peripheral signals connected spis1_mosi. 0 : Pin is connected to GPIO/LoanIO number 68. 1 : Pin is connected to Peripheral signal not applicable. 2 : Pin is connected to Peripheral signal SPIM1.MOSI. 3 : Pin is connected to Peripheral signal SPIS1.MOSI.
0x4D4 pinmuxgrp_GENERALIO21 — This register is used to control the peripherals connected to spis1_miso Only reset by a cold reset (ignores warm reset). NOTE: These registers should not be modified after IO configuration.There is no support for dynamically changing the Pin Mux selections.
  [1:0] sel — Select peripheral signals connected spis1_miso. 0 : Pin is connected to GPIO/LoanIO number 69. 1 : Pin is connected to Peripheral signal not applicable. 2 : Pin is connected to Peripheral signal SPIM1.MISO. 3 : Pin is connected to Peripheral signal SPIS1.MISO.
0x4D8 pinmuxgrp_GENERALIO22 — This register is used to control the peripherals connected to spis1_ss0 Only reset by a cold reset (ignores warm reset). NOTE: These registers should not be modified after IO configuration.There is no support for dynamically changing the Pin Mux selections.
  [1:0] sel — Select peripheral signals connected spis1_ss0. 0 : Pin is connected to GPIO/LoanIO number 70. 1 : Pin is connected to Peripheral signal not applicable. 2 : Pin is connected to Peripheral signal SPIM1.SS0. 3 : Pin is connected to Peripheral signal SPIS1.SS0.
0x4DC pinmuxgrp_GENERALIO23 — This register is used to control the peripherals connected to uart1_rx Only reset by a cold reset (ignores warm reset). NOTE: These registers should not be modified after IO configuration.There is no support for dynamically changing the Pin Mux selections.
  [1:0] sel — Select peripheral signals connected uart1_rx. 0 : Pin is connected to GPIO/LoanIO number 62. 1 : Pin is connected to Peripheral signal not applicable. 2 : Pin is connected to Peripheral signal SPIM1.SS1. 3 : Pin is connected to Peripheral signal UART1.RX.
0x4E0 pinmuxgrp_GENERALIO24 — This register is used to control the peripherals connected to uart1_tx Only reset by a cold reset (ignores warm reset). NOTE: These registers should not be modified after IO configuration.There is no support for dynamically changing the Pin Mux selections.
  [1:0] sel — Select peripheral signals connected uart1_tx. 0 : Pin is connected to GPIO/LoanIO number 63. 1 : Pin is connected to Peripheral signal not applicable. 2 : Pin is connected to Peripheral signal SPIM0.CLK. 3 : Pin is connected to Peripheral signal UART1.TX.
0x4E4 pinmuxgrp_GENERALIO25 — This register is used to control the peripherals connected to i2c1_sda Only reset by a cold reset (ignores warm reset). NOTE: These registers should not be modified after IO configuration.There is no support for dynamically changing the Pin Mux selections.
  [1:0] sel — Select peripheral signals connected i2c1_sda. 0 : Pin is connected to GPIO/LoanIO number 64. 1 : Pin is connected to Peripheral signal not applicable. 2 : Pin is connected to Peripheral signal SPIM0.MOSI. 3 : Pin is connected to Peripheral signal I2C1.SDA.
0x4E8 pinmuxgrp_GENERALIO26 — This register is used to control the peripherals connected to i2c1_scl Only reset by a cold reset (ignores warm reset). NOTE: These registers should not be modified after IO configuration.There is no support for dynamically changing the Pin Mux selections.
  [1:0] sel — Select peripheral signals connected i2c1_scl. 0 : Pin is connected to GPIO/LoanIO number 65. 1 : Pin is connected to Peripheral signal not applicable. 2 : Pin is connected to Peripheral signal SPIM0.MISO. 3 : Pin is connected to Peripheral signal I2C1.SCL.
0x4EC pinmuxgrp_GENERALIO27 — This register is used to control the peripherals connected to spim0_ss0_alt Only reset by a cold reset (ignores warm reset). NOTE: These registers should not be modified after IO configuration.There is no support for dynamically changing the Pin Mux selections.
  [1:0] sel — Select peripheral signals connected spim0_ss0_alt. 0 : Pin is connected to GPIO/LoanIO number 66. 1 : Pin is connected to Peripheral signal not applicable. 2 : Pin is connected to Peripheral signal SPIM0.SS0. 3 : Pin is connected to Peripheral signal not applicable.
0x4F0 pinmuxgrp_GENERALIO28 — This register is used to control the peripherals connected to spis0_clk Only reset by a cold reset (ignores warm reset). NOTE: These registers should not be modified after IO configuration.There is no support for dynamically changing the Pin Mux selections.
  [1:0] sel — Select peripheral signals connected spis0_clk. 0 : Pin is connected to GPIO/LoanIO number 67. 1 : Pin is connected to Peripheral signal not applicable. 2 : Pin is connected to Peripheral signal SPIM0.SS1. 3 : Pin is connected to Peripheral signal SPIS0.CLK.
0x4F4 pinmuxgrp_GENERALIO29 — This register is used to control the peripherals connected to spis0_mosi Only reset by a cold reset (ignores warm reset). NOTE: These registers should not be modified after IO configuration.There is no support for dynamically changing the Pin Mux selections.
  [1:0] sel — Select peripheral signals connected spis0_mosi. 0 : Pin is connected to GPIO/LoanIO number 68. 1 : Pin is connected to Peripheral signal not applicable. 2 : Pin is connected to Peripheral signal not applicable. 3 : Pin is connected to Peripheral signal SPIS0.MOSI.
0x4F8 pinmuxgrp_GENERALIO30 — This register is used to control the peripherals connected to spis0_miso Only reset by a cold reset (ignores warm reset). NOTE: These registers should not be modified after IO configuration.There is no support for dynamically changing the Pin Mux selections.
  [1:0] sel — Select peripheral signals connected spis0_miso. 0 : Pin is connected to GPIO/LoanIO number 69. 1 : Pin is connected to Peripheral signal not applicable. 2 : Pin is connected to Peripheral signal not applicable. 3 : Pin is connected to Peripheral signal SPIS0.MISO.
0x4FC pinmuxgrp_GENERALIO31 — This register is used to control the peripherals connected to spis0_ss0 Only reset by a cold reset (ignores warm reset). NOTE: These registers should not be modified after IO configuration.There is no support for dynamically changing the Pin Mux selections.
  [1:0] sel — Select peripheral signals connected spis0_ss0. 0 : Pin is connected to GPIO/LoanIO number 70. 1 : Pin is connected to Peripheral signal not applicable. 2 : Pin is connected to Peripheral signal not applicable. 3 : Pin is connected to Peripheral signal SPIS0.SS0.
0x500 pinmuxgrp_MIXED1IO0 — This register is used to control the peripherals connected to nand_ale Only reset by a cold reset (ignores warm reset). NOTE: These registers should not be modified after IO configuration.There is no support for dynamically changing the Pin Mux selections.
  [1:0] sel — Select peripheral signals connected nand_ale. 0 : Pin is connected to GPIO/LoanIO number 14. 1 : Pin is connected to Peripheral signal QSPI.SS3. 2 : Pin is connected to Peripheral signal RGMII1.TX_CLK. 3 : Pin is connected to Peripheral signal NAND.ale.
0x504 pinmuxgrp_MIXED1IO1 — This register is used to control the peripherals connected to nand_ce Only reset by a cold reset (ignores warm reset). NOTE: These registers should not be modified after IO configuration.There is no support for dynamically changing the Pin Mux selections.
  [1:0] sel — Select peripheral signals connected nand_ce. 0 : Pin is connected to GPIO/LoanIO number 15. 1 : Pin is connected to Peripheral signal USB1.D0. 2 : Pin is connected to Peripheral signal RGMII1.TXD0. 3 : Pin is connected to Peripheral signal NAND.ce.
0x508 pinmuxgrp_MIXED1IO2 — This register is used to control the peripherals connected to nand_cle Only reset by a cold reset (ignores warm reset). NOTE: These registers should not be modified after IO configuration.There is no support for dynamically changing the Pin Mux selections.
  [1:0] sel — Select peripheral signals connected nand_cle. 0 : Pin is connected to GPIO/LoanIO number 16. 1 : Pin is connected to Peripheral signal USB1.D1. 2 : Pin is connected to Peripheral signal RGMII1.TXD1. 3 : Pin is connected to Peripheral signal NAND.cle.
0x50C pinmuxgrp_MIXED1IO3 — This register is used to control the peripherals connected to nand_re Only reset by a cold reset (ignores warm reset). NOTE: These registers should not be modified after IO configuration.There is no support for dynamically changing the Pin Mux selections.
  [1:0] sel — Select peripheral signals connected nand_re. 0 : Pin is connected to GPIO/LoanIO number 17. 1 : Pin is connected to Peripheral signal USB1.D2. 2 : Pin is connected to Peripheral signal RGMII1.TXD2. 3 : Pin is connected to Peripheral signal NAND.re.
0x510 pinmuxgrp_MIXED1IO4 — This register is used to control the peripherals connected to nand_rb Only reset by a cold reset (ignores warm reset). NOTE: These registers should not be modified after IO configuration.There is no support for dynamically changing the Pin Mux selections.
  [1:0] sel — Select peripheral signals connected nand_rb. 0 : Pin is connected to GPIO/LoanIO number 18. 1 : Pin is connected to Peripheral signal USB1.D3. 2 : Pin is connected to Peripheral signal RGMII1.TXD3. 3 : Pin is connected to Peripheral signal NAND.rb.
0x514 pinmuxgrp_MIXED1IO5 — This register is used to control the peripherals connected to nand_dq0 Only reset by a cold reset (ignores warm reset). NOTE: These registers should not be modified after IO configuration.There is no support for dynamically changing the Pin Mux selections.
  [1:0] sel — Select peripheral signals connected nand_dq0. 0 : Pin is connected to GPIO/LoanIO number 19. 1 : Pin is connected to Peripheral signal not applicable. 2 : Pin is connected to Peripheral signal RGMII1.RXD0. 3 : Pin is connected to Peripheral signal NAND.dq0.
0x518 pinmuxgrp_MIXED1IO6 — This register is used to control the peripherals connected to nand_dq1 Only reset by a cold reset (ignores warm reset). NOTE: These registers should not be modified after IO configuration.There is no support for dynamically changing the Pin Mux selections.
  [1:0] sel — Select peripheral signals connected nand_dq1. 0 : Pin is connected to GPIO/LoanIO number 20. 1 : Pin is connected to Peripheral signal I2C3.SDA. 2 : Pin is connected to Peripheral signal RGMII1.MDIO. 3 : Pin is connected to Peripheral signal NAND.dq1.
0x51C pinmuxgrp_MIXED1IO7 — This register is used to control the peripherals connected to nand_dq2 Only reset by a cold reset (ignores warm reset). NOTE: These registers should not be modified after IO configuration.There is no support for dynamically changing the Pin Mux selections.
  [1:0] sel — Select peripheral signals connected nand_dq2. 0 : Pin is connected to GPIO/LoanIO number 21. 1 : Pin is connected to Peripheral signal I2C3.SCL. 2 : Pin is connected to Peripheral signal RGMII1.MDC. 3 : Pin is connected to Peripheral signal NAND.dq2.
0x520 pinmuxgrp_MIXED1IO8 — This register is used to control the peripherals connected to nand_dq3 Only reset by a cold reset (ignores warm reset). NOTE: These registers should not be modified after IO configuration.There is no support for dynamically changing the Pin Mux selections.
  [1:0] sel — Select peripheral signals connected nand_dq3. 0 : Pin is connected to GPIO/LoanIO number 22. 1 : Pin is connected to Peripheral signal USB1.D4. 2 : Pin is connected to Peripheral signal RGMII1.RX_CTL. 3 : Pin is connected to Peripheral signal NAND.dq3.
0x524 pinmuxgrp_MIXED1IO9 — This register is used to control the peripherals connected to nand_dq4 Only reset by a cold reset (ignores warm reset). NOTE: These registers should not be modified after IO configuration.There is no support for dynamically changing the Pin Mux selections.
  [1:0] sel — Select peripheral signals connected nand_dq4. 0 : Pin is connected to GPIO/LoanIO number 23. 1 : Pin is connected to Peripheral signal USB1.D5. 2 : Pin is connected to Peripheral signal RGMII1.TX_CTL. 3 : Pin is connected to Peripheral signal NAND.dq4.
0x528 pinmuxgrp_MIXED1IO10 — This register is used to control the peripherals connected to nand_dq5 Only reset by a cold reset (ignores warm reset). NOTE: These registers should not be modified after IO configuration.There is no support for dynamically changing the Pin Mux selections.
  [1:0] sel — Select peripheral signals connected nand_dq5. 0 : Pin is connected to GPIO/LoanIO number 24. 1 : Pin is connected to Peripheral signal USB1.D6. 2 : Pin is connected to Peripheral signal RGMII1.RX_CLK. 3 : Pin is connected to Peripheral signal NAND.dq5.
0x52C pinmuxgrp_MIXED1IO11 — This register is used to control the peripherals connected to nand_dq6 Only reset by a cold reset (ignores warm reset). NOTE: These registers should not be modified after IO configuration.There is no support for dynamically changing the Pin Mux selections.
  [1:0] sel — Select peripheral signals connected nand_dq6. 0 : Pin is connected to GPIO/LoanIO number 25. 1 : Pin is connected to Peripheral signal USB1.D7. 2 : Pin is connected to Peripheral signal RGMII1.RXD1. 3 : Pin is connected to Peripheral signal NAND.dq6.
0x530 pinmuxgrp_MIXED1IO12 — This register is used to control the peripherals connected to nand_dq7 Only reset by a cold reset (ignores warm reset). NOTE: These registers should not be modified after IO configuration.There is no support for dynamically changing the Pin Mux selections.
  [1:0] sel — Select peripheral signals connected nand_dq7. 0 : Pin is connected to GPIO/LoanIO number 26. 1 : Pin is connected to Peripheral signal not applicable. 2 : Pin is connected to Peripheral signal RGMII1.RXD2. 3 : Pin is connected to Peripheral signal NAND.dq7.
0x534 pinmuxgrp_MIXED1IO13 — This register is used to control the peripherals connected to nand_wp Only reset by a cold reset (ignores warm reset). NOTE: These registers should not be modified after IO configuration.There is no support for dynamically changing the Pin Mux selections.
  [1:0] sel — Select peripheral signals connected nand_wp. 0 : Pin is connected to GPIO/LoanIO number 27. 1 : Pin is connected to Peripheral signal QSPI.SS2. 2 : Pin is connected to Peripheral signal RGMII1.RXD3. 3 : Pin is connected to Peripheral signal NAND.wp.
0x538 pinmuxgrp_MIXED1IO14 — This register is used to control the peripherals connected to nand_we Only reset by a cold reset (ignores warm reset). NOTE: These registers should not be modified after IO configuration.There is no support for dynamically changing the Pin Mux selections.
  [1:0] sel — Select peripheral signals connected nand_we. 0 : Pin is connected to GPIO/LoanIO number 28. 1 : Pin is connected to Peripheral signal not applicable. 2 : Pin is connected to Peripheral signal QSPI.SS1. 3 : Pin is connected to Peripheral signal NAND.we.
0x53C pinmuxgrp_MIXED1IO15 — This register is used to control the peripherals connected to qspi_io0 Only reset by a cold reset (ignores warm reset). NOTE: These registers should not be modified after IO configuration.There is no support for dynamically changing the Pin Mux selections.
  [1:0] sel — Select peripheral signals connected qspi_io0. 0 : Pin is connected to GPIO/LoanIO number 29. 1 : Pin is connected to Peripheral signal USB1.CLK. 2 : Pin is connected to Peripheral signal not applicable. 3 : Pin is connected to Peripheral signal QSPI.IO0.
0x540 pinmuxgrp_MIXED1IO16 — This register is used to control the peripherals connected to qspi_io1 Only reset by a cold reset (ignores warm reset). NOTE: These registers should not be modified after IO configuration.There is no support for dynamically changing the Pin Mux selections.
  [1:0] sel — Select peripheral signals connected qspi_io1. 0 : Pin is connected to GPIO/LoanIO number 30. 1 : Pin is connected to Peripheral signal USB1.STP. 2 : Pin is connected to Peripheral signal not applicable. 3 : Pin is connected to Peripheral signal QSPI.IO1.
0x544 pinmuxgrp_MIXED1IO17 — This register is used to control the peripherals connected to qspi_io2 Only reset by a cold reset (ignores warm reset). NOTE: These registers should not be modified after IO configuration.There is no support for dynamically changing the Pin Mux selections.
  [1:0] sel — Select peripheral signals connected qspi_io2. 0 : Pin is connected to GPIO/LoanIO number 31. 1 : Pin is connected to Peripheral signal USB1.DIR. 2 : Pin is connected to Peripheral signal not applicable. 3 : Pin is connected to Peripheral signal QSPI.IO2.
0x548 pinmuxgrp_MIXED1IO18 — This register is used to control the peripherals connected to qspi_io3 Only reset by a cold reset (ignores warm reset). NOTE: These registers should not be modified after IO configuration.There is no support for dynamically changing the Pin Mux selections.
  [1:0] sel — Select peripheral signals connected qspi_io3. 0 : Pin is connected to GPIO/LoanIO number 32. 1 : Pin is connected to Peripheral signal USB1.NXT. 2 : Pin is connected to Peripheral signal not applicable. 3 : Pin is connected to Peripheral signal QSPI.IO3.
0x54C pinmuxgrp_MIXED1IO19 — This register is used to control the peripherals connected to qspi_ss0 Only reset by a cold reset (ignores warm reset). NOTE: These registers should not be modified after IO configuration.There is no support for dynamically changing the Pin Mux selections.
  [1:0] sel — Select peripheral signals connected qspi_ss0. 0 : Pin is connected to GPIO/LoanIO number 33. 1 : Pin is connected to Peripheral signal not applicable. 2 : Pin is connected to Peripheral signal not applicable. 3 : Pin is connected to Peripheral signal QSPI.SS0.
0x550 pinmuxgrp_MIXED1IO20 — This register is used to control the peripherals connected to qpsi_clk Only reset by a cold reset (ignores warm reset). NOTE: These registers should not be modified after IO configuration.There is no support for dynamically changing the Pin Mux selections.
  [1:0] sel — Select peripheral signals connected qpsi_clk. 0 : Pin is connected to GPIO/LoanIO number 34. 1 : Pin is connected to Peripheral signal not applicable. 2 : Pin is connected to Peripheral signal not applicable. 3 : Pin is connected to Peripheral signal QSPI.CLK.
0x554 pinmuxgrp_MIXED1IO21 — This register is used to control the peripherals connected to qspi_ss1 Only reset by a cold reset (ignores warm reset). NOTE: These registers should not be modified after IO configuration.There is no support for dynamically changing the Pin Mux selections.
  [1:0] sel — Select peripheral signals connected qspi_ss1. 0 : Pin is connected to GPIO/LoanIO number 35. 1 : Pin is connected to Peripheral signal not applicable. 2 : Pin is connected to Peripheral signal not applicable. 3 : Pin is connected to Peripheral signal QSPI.SS1.
0x558 pinmuxgrp_MIXED2IO0 — This register is used to control the peripherals connected to emac1_mdio Only reset by a cold reset (ignores warm reset). NOTE: These registers should not be modified after IO configuration.There is no support for dynamically changing the Pin Mux selections.
  [1:0] sel — Select peripheral signals connected emac1_mdio. 0 : Pin is connected to GPIO/LoanIO number 54. 1 : Pin is connected to Peripheral signal SPIS0.CLK. 2 : Pin is connected to Peripheral signal SPIM0.CLK. 3 : Pin is connected to Peripheral signal RGMII1.MDIO.
0x55C pinmuxgrp_MIXED2IO1 — This register is used to control the peripherals connected to emac1_mdc Only reset by a cold reset (ignores warm reset). NOTE: These registers should not be modified after IO configuration.There is no support for dynamically changing the Pin Mux selections.
  [1:0] sel — Select peripheral signals connected emac1_mdc. 0 : Pin is connected to GPIO/LoanIO number 55. 1 : Pin is connected to Peripheral signal SPIS0.MOSI. 2 : Pin is connected to Peripheral signal SPIM0.MOSI. 3 : Pin is connected to Peripheral signal RGMII1.MDC.
0x560 pinmuxgrp_MIXED2IO2 — This register is used to control the peripherals connected to emac1_tx_d2 Only reset by a cold reset (ignores warm reset). NOTE: These registers should not be modified after IO configuration.There is no support for dynamically changing the Pin Mux selections.
  [1:0] sel — Select peripheral signals connected emac1_tx_d2. 0 : Pin is connected to GPIO/LoanIO number 56. 1 : Pin is connected to Peripheral signal SPIS0.MISO. 2 : Pin is connected to Peripheral signal SPIM0.MISO. 3 : Pin is connected to Peripheral signal RGMII1.TXD2.
0x564 pinmuxgrp_MIXED2IO3 — This register is used to control the peripherals connected to emac1_tx_d3 Only reset by a cold reset (ignores warm reset). NOTE: These registers should not be modified after IO configuration.There is no support for dynamically changing the Pin Mux selections.
  [1:0] sel — Select peripheral signals connected emac1_tx_d3. 0 : Pin is connected to GPIO/LoanIO number 57. 1 : Pin is connected to Peripheral signal SPIS0.SS0. 2 : Pin is connected to Peripheral signal SPIM0.SS0. 3 : Pin is connected to Peripheral signal RGMII1.TXD3.
0x568 pinmuxgrp_MIXED2IO4 — This register is used to control the peripherals connected to emac1_rx_clk Only reset by a cold reset (ignores warm reset). NOTE: These registers should not be modified after IO configuration.There is no support for dynamically changing the Pin Mux selections.
  [1:0] sel — Select peripheral signals connected emac1_rx_clk. 0 : Pin is connected to GPIO/LoanIO number 58. 1 : Pin is connected to Peripheral signal SPIM1.CLK. 2 : Pin is connected to Peripheral signal SPIS1.CLK. 3 : Pin is connected to Peripheral signal RGMII1.RX_CLK.
0x56C pinmuxgrp_MIXED2IO5 — This register is used to control the peripherals connected to emac1_rx_ctl Only reset by a cold reset (ignores warm reset). NOTE: These registers should not be modified after IO configuration.There is no support for dynamically changing the Pin Mux selections.
  [1:0] sel — Select peripheral signals connected emac1_rx_ctl. 0 : Pin is connected to GPIO/LoanIO number 59. 1 : Pin is connected to Peripheral signal SPIM1.MOSI. 2 : Pin is connected to Peripheral signal SPIS1.MOSI. 3 : Pin is connected to Peripheral signal RGMII1.RX_CTL.
0x570 pinmuxgrp_MIXED2IO6 — This register is used to control the peripherals connected to emac1_rx_d2 Only reset by a cold reset (ignores warm reset). NOTE: These registers should not be modified after IO configuration.There is no support for dynamically changing the Pin Mux selections.
  [1:0] sel — Select peripheral signals connected emac1_rx_d2. 0 : Pin is connected to GPIO/LoanIO number 60. 1 : Pin is connected to Peripheral signal SPIM1.MISO. 2 : Pin is connected to Peripheral signal SPIS1.MISO. 3 : Pin is connected to Peripheral signal RGMII1.RXD2.
0x574 pinmuxgrp_MIXED2IO7 — This register is used to control the peripherals connected to emac1_rx_d3 Only reset by a cold reset (ignores warm reset). NOTE: These registers should not be modified after IO configuration.There is no support for dynamically changing the Pin Mux selections.
  [1:0] sel — Select peripheral signals connected emac1_rx_d3. 0 : Pin is connected to GPIO/LoanIO number 61. 1 : Pin is connected to Peripheral signal SPIM1.SS0. 2 : Pin is connected to Peripheral signal SPIS1.SS0. 3 : Pin is connected to Peripheral signal RGMII1.RXD3.
{0x4B8+4i} pinmuxgrp_GPLINMUX{i} (i=48..53) — Some GPIO/LoanIO inputs can be driven by multiple pins. This register selects the input signal for GPIO/LoanIO {i}. Only reset by a cold reset (ignores warm reset). NOTE: These registers should not be modified after IO configuration.There is no support for dynamically changing the Pin Mux selections.
  [0] sel — Select source for GPIO/LoanIO {i}. 0 : Source for GPIO/LoanIO {i} is GENERALIO{i-48}. 1 : Source for GPIO/LoanIO {i} is EMACIO{i-34}.
{0x4B8+4i} pinmuxgrp_GPLINMUX{i} (i=54..61) — Some GPIO/LoanIO inputs can be driven by multiple pins. This register selects the input signal for GPIO/LoanIO {i}. Only reset by a cold reset (ignores warm reset). NOTE: These registers should not be modified after IO configuration.There is no support for dynamically changing the Pin Mux selections.
  [0] sel — Select source for GPIO/LoanIO {i}. 0 : Source for GPIO/LoanIO {i} is GENERALIO{i-48}. 1 : Source for GPIO/LoanIO {i} is MIXED2IO{i-54}.
{0x4B8+4i} pinmuxgrp_GPLINMUX{i} (i=62..70) — Some GPIO/LoanIO inputs can be driven by multiple pins. This register selects the input signal for GPIO/LoanIO {i}. Only reset by a cold reset (ignores warm reset). NOTE: These registers should not be modified after IO configuration.There is no support for dynamically changing the Pin Mux selections.
  [0] sel — Select source for GPIO/LoanIO {i}. 0 : Source for GPIO/LoanIO {i} is GENERALIO{i-48}. 1 : Source for GPIO/LoanIO {i} is GENERALIO{i-39}.
{0x5D4+4i} pinmuxgrp_GPLMUX{i} (i=0..70) — Selection between GPIO and LoanIO output and output enable for GPIO{i} and LoanIO{i}. These signals drive the Pin Mux. The Pin Mux must be configured to use GPIO/LoanIO in addition to these settings Only reset by a cold reset (ignores warm reset). NOTE: These registers should not be modified after IO configuration.There is no support for dynamically changing the Pin Mux selections.
  [0] sel — Select source for GPIO/LoanIO {i}. 0 : LoanIO {i} controls GPIO/LOANIO[{i}] output and output enable signals. 1 : GPIO {i} controls GPIO/LOANI[{i}] output and output enable signals.
0x6F0 pinmuxgrp_NANDUSEFPGA — Selection between HPS Pins and FPGA Interface for NAND signals. Only reset by a cold reset (ignores warm reset). NOTE: These registers should not be modified after IO configuration.There is no support for dynamically changing the Pin Mux selections.
  [0] sel — Select connection for NAND. 0 : NAND uses HPS Pins. 1 : NAND uses the FPGA Inteface.
0x6F8 pinmuxgrp_RGMII1USEFPGA — Selection between HPS Pins and FPGA Interface for RGMII1 signals. Only reset by a cold reset (ignores warm reset). NOTE: These registers should not be modified after IO configuration.There is no support for dynamically changing the Pin Mux selections.
  [0] sel — Select connection for RGMII1. 0 : RGMII1 uses HPS Pins. 1 : RGMII1 uses the FPGA Inteface.
0x704 pinmuxgrp_I2C0USEFPGA — Selection between HPS Pins and FPGA Interface for I2C0 signals. Only reset by a cold reset (ignores warm reset). NOTE: These registers should not be modified after IO configuration.There is no support for dynamically changing the Pin Mux selections.
  [0] sel — Select connection for I2C0. 0 : I2C0 uses HPS Pins. 1 : I2C0 uses the FPGA Inteface.
0x714 pinmuxgrp_RGMII0USEFPGA — Selection between HPS Pins and FPGA Interface for RGMII0 signals. Only reset by a cold reset (ignores warm reset). NOTE: These registers should not be modified after IO configuration.There is no support for dynamically changing the Pin Mux selections.
  [0] sel — Select connection for RGMII0. 0 : RGMII0 uses HPS Pins. 1 : RGMII0 uses the FPGA Inteface.
0x724 pinmuxgrp_I2C3USEFPGA — Selection between HPS Pins and FPGA Interface for I2C3 signals. Only reset by a cold reset (ignores warm reset). NOTE: These registers should not be modified after IO configuration.There is no support for dynamically changing the Pin Mux selections.
  [0] sel — Select connection for I2C3. 0 : I2C3 uses HPS Pins. 1 : I2C3 uses the FPGA Inteface.
0x728 pinmuxgrp_I2C2USEFPGA — Selection between HPS Pins and FPGA Interface for I2C2 signals. Only reset by a cold reset (ignores warm reset). NOTE: These registers should not be modified after IO configuration.There is no support for dynamically changing the Pin Mux selections.
  [0] sel — Select connection for I2C2. 0 : I2C2 uses HPS Pins. 1 : I2C2 uses the FPGA Inteface.
0x72C pinmuxgrp_I2C1USEFPGA — Selection between HPS Pins and FPGA Interface for I2C1 signals. Only reset by a cold reset (ignores warm reset). NOTE: These registers should not be modified after IO configuration.There is no support for dynamically changing the Pin Mux selections.
  [0] sel — Select connection for I2C1. 0 : I2C1 uses HPS Pins. 1 : I2C1 uses the FPGA Inteface.
0x730 pinmuxgrp_SPIM1USEFPGA — Selection between HPS Pins and FPGA Interface for SPIM1 signals. Only reset by a cold reset (ignores warm reset). NOTE: These registers should not be modified after IO configuration.There is no support for dynamically changing the Pin Mux selections.
  [0] sel — Select connection for SPIM1. 0 : SPIM1 uses HPS Pins. 1 : SPIM1 uses the FPGA Inteface.
0x738 pinmuxgrp_SPIM0USEFPGA — Selection between HPS Pins and FPGA Interface for SPIM0 signals. Only reset by a cold reset (ignores warm reset). NOTE: These registers should not be modified after IO configuration.There is no support for dynamically changing the Pin Mux selections.
  [0] sel — Select connection for SPIM0. 0 : SPIM0 uses HPS Pins. 1 : SPIM0 uses the FPGA Inteface.
